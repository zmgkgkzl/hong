## CMakeLists.txt
```
#
# Copyright (c) 2020 Nordic Semiconductor ASA
#
# SPDX-License-Identifier: LicenseRef-Nordic-5-Clause
#

cmake_minimum_required(VERSION 3.20.0)

find_package(Zephyr REQUIRED HINTS $ENV{ZEPHYR_BASE})

project("Zigbee coordinator")

# NORDIC SDK APP START
target_sources(app PRIVATE
  src/main.c
)

target_include_directories(app PRIVATE include)
target_include_directories(app PRIVATE src/util)
target_include_directories(app PRIVATE src/library)
target_include_directories(app PRIVATE src)
target_include_directories(app PRIVATE src/module)
target_include_directories(app PRIVATE src/bsp)
target_include_directories(app PRIVATE src/config)

# Application directories
add_subdirectory(src/library)
add_subdirectory(src/config)
add_subdirectory(src/module)
add_subdirectory(src/bsp)

# NORDIC SDK APP END
```

## Kconfig
```
menu "Zephyr Kernel"
    source "Kconfig.zephyr"
endmenu

menu "bsp"
    rsource "src/bsp/Kconfig.bsp"
endmenu

menu "Event queue"
    rsource "src/library/Kconfig.event_queue"
endmenu

menu "Coordinator"
    rsource "src/module/Kconfig.module"
endmenu

module = APPLICATION
module-str = App
source "subsys/logging/Kconfig.template.log_config"
```

## prj.conf
```kconfig
#
# Copyright (c) 2020 Nordic Semiconductor ASA
#
# SPDX-License-Identifier: LicenseRef-Nordic-5-Clause
#

CONFIG_NCS_SAMPLES_DEFAULTS=y

CONFIG_UART_INTERRUPT_DRIVEN=y
CONFIG_SERIAL=y
CONFIG_GPIO=y

# Make sure printk is not printing to the UART console
CONFIG_CONSOLE=y
CONFIG_UART_CONSOLE=y

CONFIG_HEAP_MEM_POOL_SIZE=2048
CONFIG_MAIN_THREAD_PRIORITY=7

CONFIG_ZIGBEE=y
CONFIG_ZIGBEE_APP_UTILS=y
CONFIG_ZIGBEE_ROLE_COORDINATOR=y

# Enable DK LED and Buttons library
CONFIG_DK_LIBRARY=y
CONFIG_DK_LIBRARY_LOG_LEVEL_OFF=y

# This example requires more workqueue stack
CONFIG_SYSTEM_WORKQUEUE_STACK_SIZE=2048

# Enable nRF ECB driver
CONFIG_CRYPTO=y
CONFIG_CRYPTO_NRF_ECB=y
CONFIG_CRYPTO_INIT_PRIORITY=80

# Networking
CONFIG_NET_IPV6=n
CONFIG_NET_IP_ADDR_CHECK=n
CONFIG_NET_UDP=n

# App event mander
CONFIG_APP_EVENT_MANAGER=y
CONFIG_DATA_FIFO=y

# Zigbee app util
CONFIG_ZIGBEE_APP_UTILS_LOG_LEVEL_DBG=y
CONFIG_ZBOSS_TRACE_LOG_LEVEL_DBG=y

# Zigbee shell
CONFIG_ZIGBEE_SHELL=y
CONFIG_ZIGBEE_SHELL_DEBUG_CMD=y
CONFIG_ZIGBEE_SHELL_ENDPOINT=64

# Increase RX serial ring buffer
CONFIG_SHELL_BACKEND_SERIAL_RX_RING_BUFFER_SIZE=128


# BSP
CONFIG_BSP_SUPPORT_DBL_CLK=y
CONFIG_BSP_LONG_CLICK_TIMEOUT_MS=2000
CONFIG_BSP_MODULE_LOG_LEVEL_OFF=y
#CONFIG_BSP_MODULE_LOG_LEVEL_DBG=y
```

## boards/nrf52840dk_nrf52840.overlay
```dts
/*
 * Copyright (c) 2023 Nordic Semiconductor ASA
 *
 * SPDX-License-Identifier: LicenseRef-Nordic-5-Clause
 */
/ {
	chosen {
		ncs,zigbee-timer = &timer2;
	};
};

&timer2 {
	status = "okay";
};
```

## src/main.c
```c
// ZIGBEE coordinator

#include <zephyr/kernel.h>
#include <zephyr/device.h>
#include <zephyr/logging/log.h>

#include "bsp.h"
#include "m_coordinator.h"
#include "m_event_queue.h"
#include "m_menu.h"

LOG_MODULE_REGISTER(app, LOG_LEVEL_INF);

static void initialize(void)
{
	LOG_INF("Starting ZBOSS Coordinator example");
 
	bsp_init();
	m_menu_init();
	
	LOG_INF("ZBOSS Coordinator example started");
	m_coordinator_init();

	bsp_indication_set(BSP_INDICATE_READY);
}

int main(void)
{
	initialize();

	while (1)
	{
		m_event_dispatch();
	}

	//테스트중!
	// 2023.11.02 이우형 PUSH Test, PULL 하여 해당 라인 보이는 분은 아래에 추가 부탁 드립니다.
	// 2023.11.02 이우형 PUSH
	// 2023.11.02 홍승영 PUSH
	
	return 0;
}
 
```

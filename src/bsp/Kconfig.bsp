## src/bsp/Kconfig.bsp
```kconfig
config BSP_BUTTON_COUNT
	int "BSP button count"
	default 4
	help
	  specify button count that is used in BSP module

config BSP_MIN_BUTTON_DURATION_MS
	int "min button duration unit of ms"
	default 10

config BSP_SUPPORT_DBL_CLK
	bool "support double click"
	default y

if BSP_SUPPORT_DBL_CLK
config BSP_DBL_CLK_CHK_PERIOD_MS
	int "Double click check period unit of ms"
	default 10

config BSP_DBL_CLK_TOLERANCE_MS
	int "Double click tolerance unit of ms"
	default 300
endif

config BSP_LONG_CLICK_TIMEOUT_MS
	int "Long click timeout unit of ms"
	default 3000
	  
module = BSP_MODULE
module-str = BSP module
source "subsys/logging/Kconfig.template.log_config"
```

## src/module/Kconfig.module
```kconfig
module = APP_MODULE
module-str = App module
source "subsys/logging/Kconfig.template.log_config"
```
